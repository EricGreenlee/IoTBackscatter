/* USER CODE BEGIN Header */
/**
 ******************************************************************************
 * @file           : main.c
 * @brief          : Main program body - CDMA BPSK with optimized goldcode storage
 ******************************************************************************
 * @attention
 *
 * Copyright (c) 2025 STMicroelectronics.
 * All rights reserved.
 *
 * This software is licensed under terms that can be found in the LICENSE file
 * in the root directory of this software component.
 * If no LICENSE file comes with this software, it is provided AS-IS.
 *
 ******************************************************************************
 */
/* USER CODE END Header */
/* Includes ------------------------------------------------------------------*/
#include "main.h"

/* Private includes ----------------------------------------------------------*/
/* USER CODE BEGIN Includes */
#include <math.h>
#include <stdio.h>
#include <string.h>
#include "precomputed_samples.h" // Generated by Python script
/* USER CODE END Includes */

/* Private typedef -----------------------------------------------------------*/
/* USER CODE BEGIN PTD */

/* USER CODE END PTD */

/* Private define ------------------------------------------------------------*/
/* USER CODE BEGIN PD */
// Use parameters from precomputed samples
#define SAMPLE_RATE PRECOMPUTED_SAMPLE_RATE
#define CARRIER_FREQ PRECOMPUTED_CARRIER_FREQ
#define SAMPLES_PER_BIT PRECOMPUTED_SAMPLES_PER_BIT
#define GOLDCODE_LENGTH PRECOMPUTED_GOLDCODE_LENGTH
#define SAMPLES_PER_GOLDCODE PRECOMPUTED_SAMPLES_PER_GOLDCODE
#define GOLDCODE_TIME_MS PRECOMPUTED_GOLDCODE_TIME_MS

// Break/silence configuration
#define BREAK_BITS 1000 // Number of bit periods to transmit silence (2048 level)
/* USER CODE END PD */

/* Private macro -------------------------------------------------------------*/
/* USER CODE BEGIN PM */

/* USER CODE END PM */

/* Private variables ---------------------------------------------------------*/
DAC_HandleTypeDef hdac;
TIM_HandleTypeDef htim6;

UART_HandleTypeDef huart2;

/* USER CODE BEGIN PV */
// Frame transmission state
uint8_t current_bit_index = 0;
uint8_t total_frame_bits = PREAMBLE_LENGTH + PAYLOAD_LENGTH; // 80 bits total
uint8_t frame_complete = 0;
uint8_t transmission_active = 0;
uint8_t in_break_period = 0;
uint8_t break_bit_count = 0;

// Break/silence samples buffer - filled with 2048 (mid-level)
// uint16_t break_samples[SAMPLES_PER_GOLDCODE];

DMA_HandleTypeDef hdma_dac_ch1; // DMA handle
/* USER CODE END PV */

/* Private function prototypes -----------------------------------------------*/
void SystemClock_Config(void);
void MX_GPIO_Init(void);
void MX_USART2_UART_Init(void);
void MX_DAC_Init(void);
void MX_TIM6_Init(void);
/* USER CODE BEGIN PFP */
void MX_DMA_Init(void);
uint8_t Get_Current_Data_Bit(void);
void Initialize_Break_Samples(void);
void HAL_DAC_ConvCpltCallback(DAC_HandleTypeDef *hdac);
// void DMA1_Channel2_3_IRQHandler(void);
/* USER CODE END PFP */

/* Private user code ---------------------------------------------------------*/
/* USER CODE BEGIN 0 */

/* USER CODE END 0 */

/**
 * @brief  The application entry point.
 * @retval int
 */
int main(void)
{

  /* USER CODE BEGIN 1 */

  /* USER CODE END 1 */

  /* MCU Configuration--------------------------------------------------------*/

  /* Reset of all peripherals, Initializes the Flash interface and the Systick. */
  HAL_Init();

  /* USER CODE BEGIN Init */

  /* USER CODE END Init */

  /* Configure the system clock */
  SystemClock_Config();

  /* USER CODE BEGIN SysInit */

  /* USER CODE END SysInit */

  /* Initialize all configured peripherals */
  MX_GPIO_Init();
  MX_DMA_Init();  // Initialize DMA before DAC
  MX_TIM6_Init(); // Initialize Timer 6
  MX_USART2_UART_Init();
  MX_DAC_Init();

  /* USER CODE BEGIN 2 */

  HAL_NVIC_SetPriority(DMA1_Channel2_3_IRQn, 0, 0);
  HAL_NVIC_EnableIRQ(DMA1_Channel2_3_IRQn);

  // Report precomputed goldcode parameters
  char param_msg[200];
  sprintf(param_msg, "CDMA BPSK Transmitter - Optimized Goldcode Storage\r\n");
  HAL_UART_Transmit(&huart2, (uint8_t *)param_msg, strlen(param_msg), HAL_MAX_DELAY);

  sprintf(param_msg, "Sample Rate: %d Hz, Carrier: %d Hz, Samples/chip: %d\r\n",
          SAMPLE_RATE, CARRIER_FREQ, SAMPLES_PER_BIT);
  HAL_UART_Transmit(&huart2, (uint8_t *)param_msg, strlen(param_msg), HAL_MAX_DELAY);

  sprintf(param_msg, "Goldcode: %d chips, %d samples, %d ms per goldcode\r\n",
          GOLDCODE_LENGTH, SAMPLES_PER_GOLDCODE, GOLDCODE_TIME_MS);
  HAL_UART_Transmit(&huart2, (uint8_t *)param_msg, strlen(param_msg), HAL_MAX_DELAY);

  sprintf(param_msg, "Frame: %d preamble + %d payload = %d total bits + %d break bits\r\n",
          PREAMBLE_LENGTH, PAYLOAD_LENGTH, total_frame_bits, BREAK_BITS);
  HAL_UART_Transmit(&huart2, (uint8_t *)param_msg, strlen(param_msg), HAL_MAX_DELAY);

  sprintf(param_msg, "Flash usage: ~8KB (vs 406KB full storage - 98%% reduction!)\r\n");
  HAL_UART_Transmit(&huart2, (uint8_t *)param_msg, strlen(param_msg), HAL_MAX_DELAY);

  // // Initialize break samples (all mid-level)
  // Initialize_Break_Samples();

  // Print frame data
  char preamble_msg[] = "Preamble: ";
  HAL_UART_Transmit(&huart2, (uint8_t *)preamble_msg, sizeof(preamble_msg) - 1, HAL_MAX_DELAY);
  for (int i = 0; i < PREAMBLE_LENGTH; i++)
  {
    char bit_char = preamble_bits[i] ? '1' : '0';
    HAL_UART_Transmit(&huart2, (uint8_t *)&bit_char, 1, HAL_MAX_DELAY);
  }
  HAL_UART_Transmit(&huart2, (uint8_t *)"\r\n", 2, HAL_MAX_DELAY);

  char payload_msg[] = "Payload:  ";
  HAL_UART_Transmit(&huart2, (uint8_t *)payload_msg, sizeof(payload_msg) - 1, HAL_MAX_DELAY);
  for (int i = 0; i < PAYLOAD_LENGTH; i++)
  {
    char bit_char = payload_bits[i] ? '1' : '0';
    HAL_UART_Transmit(&huart2, (uint8_t *)&bit_char, 1, HAL_MAX_DELAY);
  }
  HAL_UART_Transmit(&huart2, (uint8_t *)"\r\n", 2, HAL_MAX_DELAY);

  // Start transmission with first data bit
  current_bit_index = 0;
  uint8_t first_bit = Get_Current_Data_Bit();
  const uint16_t *first_goldcode = GET_GOLDCODE_SAMPLES(first_bit);

  // Start DAC with DMA using first goldcode sequence
  if (HAL_DAC_Start_DMA(&hdac, DAC_CHANNEL_1,
                        (uint32_t *)first_goldcode,
                        SAMPLES_PER_GOLDCODE,
                        DAC_ALIGN_12B_R) != HAL_OK)
  {
    char error_msg[] = "ERROR: DAC DMA start failed!\r\n";
    HAL_UART_Transmit(&huart2, (uint8_t *)error_msg, sizeof(error_msg) - 1, HAL_MAX_DELAY);
  }
  else
  {
    char dac_msg[100];
    sprintf(dac_msg, "DAC DMA started - transmitting bit %d (%s goldcode)\r\n",
            current_bit_index, first_bit ? "normal" : "inverted");
    HAL_UART_Transmit(&huart2, (uint8_t *)dac_msg, strlen(dac_msg), HAL_MAX_DELAY);
    transmission_active = 1;
  }

  // Start Timer 6 to trigger DAC
  if (HAL_TIM_Base_Start(&htim6) != HAL_OK)
  {
    char timer_error[] = "ERROR: Timer 6 start failed!\r\n";
    HAL_UART_Transmit(&huart2, (uint8_t *)timer_error, sizeof(timer_error) - 1, HAL_MAX_DELAY);
  }
  else
  {
    char timer_msg[] = "Timer 6 started - CDMA transmission active\r\n";
    HAL_UART_Transmit(&huart2, (uint8_t *)timer_msg, sizeof(timer_msg) - 1, HAL_MAX_DELAY);
  }

  HAL_Delay(100); // Give it time to start

  // Check DMA status
  char dma_debug[100];
  sprintf(dma_debug, "DMA State: %d, Error: 0x%08X\r\n",
          hdma_dac_ch1.State, hdma_dac_ch1.ErrorCode);
  HAL_UART_Transmit(&huart2, (uint8_t *)dma_debug, strlen(dma_debug), HAL_MAX_DELAY);

  // Check DAC status
  sprintf(dma_debug, "DAC State: %d, Error: 0x%08X\r\n",
          hdac.State, hdac.ErrorCode);
  HAL_UART_Transmit(&huart2, (uint8_t *)dma_debug, strlen(dma_debug), HAL_MAX_DELAY);

  // Check Timer 6 status
  sprintf(dma_debug, "Timer6 State: %d, Counter: %d\r\n",
          htim6.State, __HAL_TIM_GET_COUNTER(&htim6));
  HAL_UART_Transmit(&huart2, (uint8_t *)dma_debug, strlen(dma_debug), HAL_MAX_DELAY);

  // Check if DMA is actually transferring
  uint32_t remaining = __HAL_DMA_GET_COUNTER(&hdma_dac_ch1);
  sprintf(dma_debug, "DMA remaining count: %d (should be decreasing)\r\n", remaining);
  HAL_UART_Transmit(&huart2, (uint8_t *)dma_debug, strlen(dma_debug), HAL_MAX_DELAY);

  HAL_Delay(1000);

  // Check again after 1 second
  remaining = __HAL_DMA_GET_COUNTER(&hdma_dac_ch1);
  sprintf(dma_debug, "DMA remaining count after 1s: %d\r\n", remaining);
  HAL_UART_Transmit(&huart2, (uint8_t *)dma_debug, strlen(dma_debug), HAL_MAX_DELAY);

  /* USER CODE END 2 */

  /* Infinite loop */
  /* USER CODE BEGIN WHILE */
  while (1)
  {
    /* USER CODE END WHILE */

    /* USER CODE BEGIN 3 */
    HAL_GPIO_TogglePin(LD2_GPIO_Port, LD2_Pin);

    // Status information
    char status_msg[150];
    if (frame_complete)
    {
      sprintf(status_msg, "Frame complete! Transmitted %d data bits + %d break bits\r\n",
              total_frame_bits, BREAK_BITS);
      frame_complete = 0; // Reset flag
    }
    else if (in_break_period)
    {
      sprintf(status_msg, "Break period: %d/%d silence bits transmitted\r\n",
              break_bit_count, BREAK_BITS);
    }
    else if (transmission_active)
    {
      sprintf(status_msg, "Transmitting bit %d/%d - %s goldcode\r\n",
              current_bit_index + 1, total_frame_bits,
              Get_Current_Data_Bit() ? "normal" : "inverted");
    }
    else
    {
      sprintf(status_msg, "Transmission inactive\r\n");
    }
    HAL_UART_Transmit(&huart2, (uint8_t *)status_msg, strlen(status_msg), HAL_MAX_DELAY);

    HAL_Delay(2000);
  }
  /* USER CODE END 3 */
}

/**
 * @brief System Clock Configuration
 * @retval None
 */
void SystemClock_Config(void)
{
  RCC_OscInitTypeDef RCC_OscInitStruct = {0};
  RCC_ClkInitTypeDef RCC_ClkInitStruct = {0};
  RCC_PeriphCLKInitTypeDef PeriphClkInit = {0};

  /** Configure the main internal regulator output voltage
   */
  __HAL_PWR_VOLTAGESCALING_CONFIG(PWR_REGULATOR_VOLTAGE_SCALE1);

  /** Initializes the RCC Oscillators according to the specified parameters
   * in the RCC_OscInitTypeDef structure.
   */
  RCC_OscInitStruct.OscillatorType = RCC_OSCILLATORTYPE_MSI;
  RCC_OscInitStruct.MSIState = RCC_MSI_ON;
  RCC_OscInitStruct.MSICalibrationValue = 0;
  RCC_OscInitStruct.MSIClockRange = RCC_MSIRANGE_5;
  RCC_OscInitStruct.PLL.PLLState = RCC_PLL_NONE;
  if (HAL_RCC_OscConfig(&RCC_OscInitStruct) != HAL_OK)
  {
    Error_Handler();
  }

  /** Initializes the CPU, AHB and APB buses clocks
   */
  RCC_ClkInitStruct.ClockType = RCC_CLOCKTYPE_HCLK | RCC_CLOCKTYPE_SYSCLK | RCC_CLOCKTYPE_PCLK1 | RCC_CLOCKTYPE_PCLK2;
  RCC_ClkInitStruct.SYSCLKSource = RCC_SYSCLKSOURCE_MSI;
  RCC_ClkInitStruct.AHBCLKDivider = RCC_SYSCLK_DIV1;
  RCC_ClkInitStruct.APB1CLKDivider = RCC_HCLK_DIV1;
  RCC_ClkInitStruct.APB2CLKDivider = RCC_HCLK_DIV1;

  if (HAL_RCC_ClockConfig(&RCC_ClkInitStruct, FLASH_LATENCY_0) != HAL_OK)
  {
    Error_Handler();
  }
  PeriphClkInit.PeriphClockSelection = RCC_PERIPHCLK_USART2;
  PeriphClkInit.Usart2ClockSelection = RCC_USART2CLKSOURCE_PCLK1;
  if (HAL_RCCEx_PeriphCLKConfig(&PeriphClkInit) != HAL_OK)
  {
    Error_Handler();
  }
}

/**
 * @brief DAC Initialization Function
 * @param None
 * @retval None
 */
void MX_DAC_Init(void)
{

  /* USER CODE BEGIN DAC_Init 0 */

  /* USER CODE END DAC_Init 0 */

  DAC_ChannelConfTypeDef sConfig = {0};

  /* USER CODE BEGIN DAC_Init 1 */

  /* USER CODE END DAC_Init 1 */

  /** DAC Initialization
   */
  hdac.Instance = DAC;
  if (HAL_DAC_Init(&hdac) != HAL_OK)
  {
    Error_Handler();
  }

  /** DAC channel OUT1 config
   */
  sConfig.DAC_Trigger = DAC_TRIGGER_T6_TRGO; // Use Timer 6 trigger
  sConfig.DAC_OutputBuffer = DAC_OUTPUTBUFFER_ENABLE;
  if (HAL_DAC_ConfigChannel(&hdac, &sConfig, DAC_CHANNEL_1) != HAL_OK)
  {
    Error_Handler();
  }
  /* USER CODE BEGIN DAC_Init 2 */

  /* USER CODE END DAC_Init 2 */
}

/**
 * @brief USART2 Initialization Function
 * @param None
 * @retval None
 */
void MX_USART2_UART_Init(void)
{

  /* USER CODE BEGIN USART2_Init 0 */

  /* USER CODE END USART2_Init 0 */

  /* USER CODE BEGIN USART2_Init 1 */

  /* USER CODE END USART2_Init 1 */
  huart2.Instance = USART2;
  huart2.Init.BaudRate = 115200;
  huart2.Init.WordLength = UART_WORDLENGTH_8B;
  huart2.Init.StopBits = UART_STOPBITS_1;
  huart2.Init.Parity = UART_PARITY_NONE;
  huart2.Init.Mode = UART_MODE_TX_RX;
  huart2.Init.HwFlowCtl = UART_HWCONTROL_NONE;
  huart2.Init.OverSampling = UART_OVERSAMPLING_16;
  huart2.Init.OneBitSampling = UART_ONE_BIT_SAMPLE_DISABLE;
  huart2.AdvancedInit.AdvFeatureInit = UART_ADVFEATURE_NO_INIT;
  if (HAL_UART_Init(&huart2) != HAL_OK)
  {
    Error_Handler();
  }
  /* USER CODE BEGIN USART2_Init 2 */

  /* USER CODE END USART2_Init 2 */
}

/**
 * @brief GPIO Initialization Function
 * @param None
 * @retval None
 */
void MX_GPIO_Init(void)
{
  GPIO_InitTypeDef GPIO_InitStruct = {0};
  /* USER CODE BEGIN MX_GPIO_Init_1 */

  /* USER CODE END MX_GPIO_Init_1 */

  /* GPIO Ports Clock Enable */
  __HAL_RCC_GPIOC_CLK_ENABLE();
  __HAL_RCC_GPIOH_CLK_ENABLE();
  __HAL_RCC_GPIOA_CLK_ENABLE();

  /*Configure GPIO pin Output Level */
  HAL_GPIO_WritePin(LD2_GPIO_Port, LD2_Pin, GPIO_PIN_RESET);

  /*Configure GPIO pin : B1_Pin */
  GPIO_InitStruct.Pin = B1_Pin;
  GPIO_InitStruct.Mode = GPIO_MODE_IT_FALLING;
  GPIO_InitStruct.Pull = GPIO_NOPULL;
  HAL_GPIO_Init(B1_GPIO_Port, &GPIO_InitStruct);

  /*Configure GPIO pin : LD2_Pin */
  GPIO_InitStruct.Pin = LD2_Pin;
  GPIO_InitStruct.Mode = GPIO_MODE_OUTPUT_PP;
  GPIO_InitStruct.Pull = GPIO_NOPULL;
  GPIO_InitStruct.Speed = GPIO_SPEED_FREQ_LOW;
  HAL_GPIO_Init(LD2_GPIO_Port, &GPIO_InitStruct);

  /* USER CODE BEGIN MX_GPIO_Init_2 */

  /* USER CODE END MX_GPIO_Init_2 */
}

/* USER CODE BEGIN 4 */
// void Initialize_Break_Samples(void)
// {
//   // Fill break samples buffer with mid-level voltage (1.65V)
//   for (int i = 0; i < SAMPLES_PER_GOLDCODE; i++)
//   {
//     break_samples[i] = 2048; // Mid-level DAC value
//   }
// }

uint8_t Get_Current_Data_Bit(void)
{
  // Return current bit from preamble or payload
  if (current_bit_index < PREAMBLE_LENGTH)
  {
    return preamble_bits[current_bit_index];
  }
  else
  {
    return payload_bits[current_bit_index - PREAMBLE_LENGTH];
  }
}

void HAL_DAC_ConvCpltCallback(DAC_HandleTypeDef *hdac_callback)
{
  // Called when DMA completes one goldcode/break transmission
  char debug_char = '0' + current_bit_index;
  HAL_UART_Transmit(&huart2, (uint8_t *)&debug_char, 1, 10); // Short timeout

  if (in_break_period)
  {
    // Currently in break period
    break_bit_count++;

    if (break_bit_count >= BREAK_BITS)
    {
      // Break period complete, restart frame
      in_break_period = 0;
      break_bit_count = 0;
      current_bit_index = 0;
      frame_complete = 1; // Set completion flag for status

      // Start first data bit of new frame
      uint8_t first_bit = Get_Current_Data_Bit();
      const uint16_t *first_goldcode = GET_GOLDCODE_SAMPLES(first_bit);

      HAL_DAC_Stop_DMA(hdac_callback, DAC_CHANNEL_1);
      HAL_DAC_Start_DMA(hdac_callback, DAC_CHANNEL_1,
                        (uint32_t *)first_goldcode,
                        SAMPLES_PER_GOLDCODE,
                        DAC_ALIGN_12B_R);
    }
    else
    {
      // Continue break period with another silence bit
      HAL_DAC_Stop_DMA(hdac_callback, DAC_CHANNEL_1);
      HAL_DAC_Start_DMA(hdac_callback, DAC_CHANNEL_1,
                        (uint32_t *)break_samples,
                        SAMPLES_PER_GOLDCODE,
                        DAC_ALIGN_12B_R);
    }
  }
  else
  {
    // Currently transmitting data bits
    current_bit_index++;

    if (current_bit_index >= total_frame_bits)
    {
      // Data frame complete, start break period
      in_break_period = 1;
      break_bit_count = 0;

      // Start break period with silence
      HAL_DAC_Stop_DMA(hdac_callback, DAC_CHANNEL_1);
      HAL_DAC_Start_DMA(hdac_callback, DAC_CHANNEL_1,
                        (uint32_t *)break_samples,
                        SAMPLES_PER_GOLDCODE,
                        DAC_ALIGN_12B_R);
    }
    else
    {
      // Continue with next data bit
      uint8_t next_bit = Get_Current_Data_Bit();
      const uint16_t *next_goldcode = GET_GOLDCODE_SAMPLES(next_bit);

      HAL_DAC_Stop_DMA(hdac_callback, DAC_CHANNEL_1);
      HAL_DAC_Start_DMA(hdac_callback, DAC_CHANNEL_1,
                        (uint32_t *)next_goldcode,
                        SAMPLES_PER_GOLDCODE,
                        DAC_ALIGN_12B_R);
    }
  }

  // // Check for DMA start failure
  // if (HAL_DAC_Start_DMA(hdac_callback, DAC_CHANNEL_1,
  //                       (uint32_t *)break_samples, // This won't execute, just for error checking
  //                       SAMPLES_PER_GOLDCODE,
  //                       DAC_ALIGN_12B_R) != HAL_OK)
  // {
  //   transmission_active = 0; // Mark transmission as failed
  // }
}

// void DMA1_Channel2_3_IRQHandler(void)
// {
//   HAL_DMA_IRQHandler(&hdma_dac_ch1);
// }

void MX_TIM6_Init(void)
{
  TIM_MasterConfigTypeDef sMasterConfig = {0};

  __HAL_RCC_TIM6_CLK_ENABLE();

  htim6.Instance = TIM6;
  htim6.Init.Prescaler = 0;
  htim6.Init.CounterMode = TIM_COUNTERMODE_UP;
  htim6.Init.Period = (SystemCoreClock / SAMPLE_RATE) - 1;
  htim6.Init.AutoReloadPreload = TIM_AUTORELOAD_PRELOAD_DISABLE;
  HAL_TIM_Base_Init(&htim6);

  sMasterConfig.MasterOutputTrigger = TIM_TRGO_UPDATE;
  sMasterConfig.MasterSlaveMode = TIM_MASTERSLAVEMODE_DISABLE;
  HAL_TIMEx_MasterConfigSynchronization(&htim6, &sMasterConfig);
}

void MX_DMA_Init(void)
{
  __HAL_RCC_DMA1_CLK_ENABLE();

  hdma_dac_ch1.Instance = DMA1_Channel2;
  hdma_dac_ch1.Init.Request = DMA_REQUEST_9;
  hdma_dac_ch1.Init.Direction = DMA_MEMORY_TO_PERIPH;
  hdma_dac_ch1.Init.PeriphInc = DMA_PINC_DISABLE;
  hdma_dac_ch1.Init.MemInc = DMA_MINC_ENABLE;
  hdma_dac_ch1.Init.PeriphDataAlignment = DMA_PDATAALIGN_HALFWORD;
  hdma_dac_ch1.Init.MemDataAlignment = DMA_MDATAALIGN_HALFWORD;
  hdma_dac_ch1.Init.Mode = DMA_NORMAL; // Single transfer per goldcode
  hdma_dac_ch1.Init.Priority = DMA_PRIORITY_HIGH;
  HAL_DMA_Init(&hdma_dac_ch1);

  __HAL_LINKDMA(&hdac, DMA_Handle1, hdma_dac_ch1);

  // // Enable DMA interrupt for completion callback
  // HAL_NVIC_SetPriority(DMA1_Channel2_3_IRQn, 0, 0);
  // HAL_NVIC_EnableIRQ(DMA1_Channel2_3_IRQn);
}
/* USER CODE END 4 */

/**
 * @brief  This function is executed in case of error occurrence.
 * @retval None
 */
void Error_Handler(void)
{
  /* USER CODE BEGIN Error_Handler_Debug */
  /* User can add his own implementation to report the HAL error return state */
  __disable_irq();
  while (1)
  {
  }
  /* USER CODE END Error_Handler_Debug */
}

#ifdef USE_FULL_ASSERT
/**
 * @brief  Reports the name of the source file and the source line number
 *         where the assert_param error has occurred.
 * @param  file: pointer to the source file name
 * @param  line: assert_param error line source number
 * @retval None
 */
void assert_failed(uint8_t *file, uint32_t line)
{
  /* USER CODE BEGIN 6 */
  /* User can add his own implementation to report the file name and line number,
     ex: printf("Wrong parameters value: file %s on line %d\r\n", file, line) */
  /* USER CODE END 6 */
}
#endif /* USE_FULL_ASSERT */